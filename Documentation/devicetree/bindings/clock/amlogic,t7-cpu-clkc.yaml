## Documentation/devicetree/bindings/media/amlogic,t7-vcodec-dec.yaml
```yaml
# SPDX-License-Identifier: (GPL-2.0-only OR BSD-2-Clause)
%YAML 1.2
---
$id: http://devicetree.org/schemas/media/amlogic,t7-vcodec-dec.yaml#
$schema: http://devicetree.org/meta-schemas/core.yaml#

title: Amlogic T7 VDEC Video Decoder

maintainers:
  - Zhentao Guo <zhentao.guo@amlogic.com>

description: |
  T7 VDEC uses DOS DBUS isolation and a secure power domain, without the S4
  DMC request register. HEVC has a separate secure domain and functional
  front/back clock pair. The DOS mapping overlaps HCODEC, so the engines need a shared
  register owner before concurrent operation can be supported. Normal board
  device trees keep this node disabled pending decoder validation.

properties:
  compatible:
    const: amlogic,t7-vcodec-dec

  reg:
    maxItems: 1

  reg-names:
    const: dos

  interrupts:
    minItems: 1
    items:
      - description: VDEC mailbox 1
      - description: HEVC mailbox 0

  clocks:
    minItems: 5
    maxItems: 9

  clock-names:
    minItems: 5
    items:
      - const: vdec
      - const: clk_vdec_mux
      - const: sys-apb
      - const: a73-apb
      - const: vdec-p0
      - const: clk_hevcf_mux
      - const: hevc-p0
      - const: clk_hevcb_mux
      - const: hevcb-p0

  power-domains:
    minItems: 2
    items:
      - description: VDEC core, with secure memory/isolation/reset control
      - description: NIC3 parent, held for DOS-top access before core power-on
      - description: HEVC core, with secure memory/isolation/reset control

  power-domain-names:
    minItems: 2
    items:
      - const: vdec
      - const: nic3
      - const: hevc

  amlogic,canvas:
    description: Canvas lookup table provider.
    $ref: /schemas/types.yaml#/definitions/phandle

required:
  - compatible
  - reg
  - reg-names
  - interrupts
  - clocks
  - clock-names
  - power-domains
  - power-domain-names
  - amlogic,canvas

allOf:
  - if:
      properties:
        power-domain-names:
          minItems: 3
    then:
      properties:
        interrupts:
          minItems: 2
        clocks:
          minItems: 9
        clock-names:
          minItems: 9
        power-domains:
          minItems: 3
    else:
      properties:
        interrupts:
          maxItems: 1
        clocks:
          maxItems: 5
        clock-names:
          maxItems: 5
        power-domains:
          maxItems: 2

additionalProperties: false

examples:
  - |
    #include <dt-bindings/interrupt-controller/arm-gic.h>
    #include <dt-bindings/clock/amlogic,t7-peripherals-clkc.h>
    #include <dt-bindings/power/amlogic,t7-pwrc.h>
    video-codec@fe320000 {
        compatible = "amlogic,t7-vcodec-dec";
        reg = <0xfe320000 0x10000>;
        reg-names = "dos";
        interrupts = <GIC_SPI 92 IRQ_TYPE_EDGE_RISING>;
        clocks = <&clkc_periphs CLKID_SYS_DOS>,
                 <&clkc_periphs CLKID_VDEC>,
                 <&clkc_periphs CLKID_SYS_PCLK_SYS_APB>,
                 <&clkc_periphs CLKID_SYS_A73PCLK_APB>,
                 <&clkc_periphs CLKID_VDEC_0>;
        clock-names = "vdec", "clk_vdec_mux", "sys-apb", "a73-apb", "vdec-p0";
        power-domains = <&pwrc PWRC_T7_DOS_VDEC_ID>,
                        <&pwrc PWRC_T7_NIC3_ID>;
        power-domain-names = "vdec", "nic3";
        amlogic,canvas = <&canvas>;
        status = "disabled";
    };
```

## Documentation/devicetree/bindings/media/amlogic,t7-vdin-test.yaml
```yaml
# SPDX-License-Identifier: (GPL-2.0-only OR BSD-2-Clause)
%YAML 1.2
---
$id: http://devicetree.org/schemas/media/amlogic,t7-vdin-test.yaml#
$schema: http://devicetree.org/meta-schemas/core.yaml#

title: Amlogic T7 VDIN capture experiment

maintainers:
  - localhost-copilot <318096335+localhost-copilot@users.noreply.github.com>

description: |
  Experimental capture node describing the complete VPU register window.
  The normal display VPU must remain disabled.
  Only the split profile permits the fixed OSD1 display handoff experiment;
  the display consumer must not touch reset or write-arbitration registers.

properties:
  compatible:
    const: amlogic,t7-vdin-test
  reg:
    maxItems: 1
  amlogic,split-vcbus:
    type: boolean
    description: |
      Reserve and map only four capture windows inside VCBUS rather than
      reserving the complete aperture: VDIN0/HDR2 (ff004800/400), VPU_SW_RESET
      (ff009c80/4), write arbitration (ff009e88/8), and VDIN top/double-write
      (ff01042c/c). No other capture registers may be accessed in this profile.
  interrupts:
    maxItems: 1
    description: VDIN0 memory write completion
  power-domains:
    items:
      - description: VPU HDMI power island
      - description: VI CLK1 power island
      - description: VI CLK2 power island
  clocks:
    maxItems: 5
  clock-names:
    items:
      - const: pclk
      - const: vpu
      - const: vapb
      - const: clkb
      - const: measure
  amlogic,receiver:
    $ref: /schemas/types.yaml#/definitions/phandle
    description: HDMI receiver supplying the progressive 1080p60 signal

required:
  - compatible
  - reg
  - interrupts
  - power-domains
  - clocks
  - clock-names
  - amlogic,receiver

additionalProperties: false
```

## Documentation/devicetree/bindings/media/cec/amlogic,t7-ao-cec.yaml
```yaml
# SPDX-License-Identifier: (GPL-2.0-only OR BSD-2-Clause)
%YAML 1.2
---
$id: http://devicetree.org/schemas/media/cec/amlogic,t7-ao-cec.yaml#
$schema: http://devicetree.org/meta-schemas/core.yaml#

title: Amlogic T7 AO CEC A controller

maintainers:
  - localhost-copilot <318096335+localhost-copilot@users.noreply.github.com>

description: |
  The T7 CECA controller has the Meson AO CEC command interface, external
  peripheral clocks and a system clock filter. CECB can redirect its output
  onto the CECA pad. The CECA driver owns the CECB routing word to prevent
  concurrent use of that controller on the same physical wire.

allOf:
  - $ref: cec-common.yaml#

properties:
  compatible:
    const: amlogic,t7-ao-cec

  reg:
    items:
      - description: CECA controller registers
      - description: CECB general control and pad routing register

  reg-names:
    items:
      - const: core
      - const: cecb-route

  clocks:
    items:
      - description: CECA 32768 Hz clock
      - description: CEC peripheral register clock

  clock-names:
    items:
      - const: core
      - const: pclk

  interrupts:
    maxItems: 1

required:
  - compatible
  - reg
  - reg-names
  - clocks
  - clock-names
  - interrupts
  - hdmi-phandle

unevaluatedProperties: false

examples:
  - |
    cec@fe044000 {
        compatible = "amlogic,t7-ao-cec";
        reg = <0xfe044000 0x14>, <0xfe044040 0x4>;
        reg-names = "core", "cecb-route";
        clocks = <&clkc 9>, <&clkc 149>;
        clock-names = "core", "pclk";
        interrupts = <179>;
        hdmi-phandle = <&hdmi_tx>;
    };
```

## Documentation/devicetree/bindings/media/cnm,wave521c.yaml
```yaml
# SPDX-License-Identifier: (GPL-2.0 OR BSD-2-Clause)
%YAML 1.2
---
$id: http://devicetree.org/schemas/media/cnm,wave521c.yaml#
$schema: http://devicetree.org/meta-schemas/core.yaml#

title: Chips&Media Wave 5 Series multi-standard codec IP

maintainers:
  - Nas Chung <nas.chung@chipsnmedia.com>
  - Jackson Lee <jackson.lee@chipsnmedia.com>

description:
  The Chips&Media WAVE codec IP is a multi format video encoder/decoder

properties:
  compatible:
    oneOf:
      - items:
          - const: ti,j721s2-wave521c
          - const: cnm,wave521c
      - const: amlogic,t7-wave521c

  reg:
    maxItems: 1

  clocks:
    minItems: 1
    maxItems: 5

  clock-names:
    minItems: 1
    maxItems: 5

  interrupts:
    maxItems: 1

  power-domains:
    maxItems: 1

  resets:
    maxItems: 1

  sram:
    maxItems: 1
    description:
      The VPU uses the SRAM to store some of the reference data instead of
      storing it on DMA memory. It is mainly used for the purpose of reducing
      bandwidth.

required:
  - compatible
  - reg
  - clocks

allOf:
  - if:
      properties:
        compatible:
          contains:
            const: amlogic,t7-wave521c
    then:
      properties:
        clocks:
          items:
            - description: DOS register clock
            - description: VPU APB clock
            - description: Wave AXI clock (A)
            - description: Wave bitstream processor clock (B)
            - description: Wave video codec clock (C)
        clock-names:
          items:
            - const: pclk
            - const: apb
            - const: axi
            - const: bpu
            - const: vce
      required:
        - clock-names
        - interrupts
        - power-domains
        - resets
    else:
      properties:
        clocks:
          items:
            - description: VCODEC clock
        clock-names: false

additionalProperties: false

examples:
  - |
    vpu: video-codec@12345678 {
        compatible = "ti,j721s2-wave521c", "cnm,wave521c";
        reg = <0x12345678 0x1000>;
        clocks = <&clks 42>;
        interrupts = <42>;
        sram = <&sram>;
    };
```

## Documentation/devicetree/bindings/misc/amlogic,t7c-adla.yaml
```yaml
# SPDX-License-Identifier: (GPL-2.0-only OR BSD-2-Clause)
%YAML 1.2
---
$id: http://devicetree.org/schemas/misc/amlogic,t7c-adla.yaml#
$schema: http://devicetree.org/meta-schemas/core.yaml#

title: Amlogic T7C ADLA neural processing accelerator

maintainers:
  - localhost-copilot <318096335+localhost-copilot@users.noreply.github.com>

description: |
  T7C ADLA has an internal address translation unit and AXI SRAM.
  It is distinct from the four Amazon NNA instances on earlier T7 silicon.

properties:
  compatible:
    const: amlogic,t7c-adla
  reg:
    maxItems: 2
  reg-names:
    items:
      - const: adla_reg
      - const: adla_sram
  interrupts:
    maxItems: 1
  interrupt-names:
    const: adla
  clocks:
    maxItems: 4
  clock-names:
    items:
      - const: adla_core_clk
      - const: adla_clk
      - const: adla_clk_parent0
      - const: adla_clk_parent1
  power-domains:
    maxItems: 1
  vddnpu-supply: true

required:
  - compatible
  - reg
  - reg-names
  - interrupts
  - interrupt-names
  - clocks
  - clock-names
  - power-domains

additionalProperties: false
```

## Documentation/devicetree/bindings/opp/amlogic,s4-cpu-operating-points.yaml
```yaml
# SPDX-License-Identifier: (GPL-2.0-only OR BSD-2-Clause)
%YAML 1.2
---
$id: http://devicetree.org/schemas/opp/amlogic,s4-cpu-operating-points.yaml#
$schema: http://devicetree.org/meta-schemas/core.yaml#

title: Amlogic S4 and T7 CPU OPP

maintainers:
  - Christian Hewitt <christianshewitt@gmail.com>

description: |
  Amlogic S4 SoCs are binned at manufacture, and the CPU voltage for each
  OPP depends on the bin. The secure monitor firmware reports the bin,
  where a higher bin is better silicon that runs the same frequency at a
  lower voltage. Each OPP lists the voltage for a bin in
  opp-microvolt-bin<N>, and falls back to opp-microvolt for bins it does
  not list. T7 has one OPP table per cluster, and the firmware reports
  the bin of each cluster.

allOf:
  - $ref: opp-v2-base.yaml#

properties:
  compatible:
    enum:
      - amlogic,s4-cpu-operating-points
      - amlogic,t7-cpu-operating-points

  amlogic,secure-monitor:
    description: phandle to the secure monitor that reports the bin
    $ref: /schemas/types.yaml#/definitions/phandle-array
    items:
      - items:
          - description: phandle to the secure monitor

  opp-shared: true

required:
  - compatible
  - amlogic,secure-monitor

patternProperties:
  "^opp-[0-9]+$":
    type: object

    properties:
      opp-hz: true
      clock-latency-ns: true
      opp-microvolt: true

    patternProperties:
      "^opp-microvolt-bin[0-9]$": true

    required:
      - opp-hz
      - opp-microvolt

    unevaluatedProperties: false

additionalProperties: false

examples:
  - |
    opp-table {
        compatible = "amlogic,s4-cpu-operating-points";
        amlogic,secure-monitor = <&sm>;
        opp-shared;

        opp-100000000 {
            opp-hz = /bits/ 64 <100000000>;
            opp-microvolt = <769000>;
            opp-microvolt-bin2 = <759000>;
            opp-microvolt-bin3 = <759000>;
        };

        opp-1704000000 {
            opp-hz = /bits/ 64 <1704000000>;
            opp-microvolt = <909000>;
            opp-microvolt-bin2 = <829000>;
            opp-microvolt-bin3 = <809000>;
        };
    };
```

## Documentation/devicetree/bindings/sound/amlogic,t7-aed.yaml
```yaml
# SPDX-License-Identifier: (GPL-2.0-only OR BSD-2-Clause)
%YAML 1.2
---
$id: http://devicetree.org/schemas/sound/amlogic,t7-aed.yaml#
$schema: http://devicetree.org/meta-schemas/core.yaml#

title: Amlogic T7 stereo audio effects engine

maintainers:
  - localhost-copilot <318096335+localhost-copilot@users.noreply.github.com>

allOf:
  - $ref: dai-common.yaml#

properties:
  compatible:
    const: amlogic,t7-aed
  reg:
    maxItems: 1
  clocks:
    items:
      - description: Peripheral gate
      - description: Processing clock
  clock-names:
    items:
      - const: pclk
      - const: clk
  power-domains:
    maxItems: 1
  '#sound-dai-cells':
    const: 0

required:
  - compatible
  - reg
  - clocks
  - clock-names
  - power-domains
  - '#sound-dai-cells'

unevaluatedProperties: false
```

## Documentation/devicetree/bindings/sound/amlogic,t7-asrc.yaml
```yaml
# SPDX-License-Identifier: (GPL-2.0-only OR BSD-2-Clause)
%YAML 1.2
---
$id: http://devicetree.org/schemas/sound/amlogic,t7-asrc.yaml#
$schema: http://devicetree.org/meta-schemas/core.yaml#

title: Amlogic T7 asynchronous sample rate converter

maintainers:
  - localhost-copilot <318096335+localhost-copilot@users.noreply.github.com>

description: |
  ASRC A receives one of the digital audio sources and feeds TODDR source 13.
  ASRC B receives TDMIN loopback and converts it to 16 kHz for loopback A.
  The coefficient SRAM ports belong to the engine, while channel sync uses
  a separate register in the audio bus. Both are owned by this component.

allOf:
  - $ref: dai-common.yaml#

properties:
  compatible:
    enum:
      - amlogic,t7-asrc-a
      - amlogic,t7-asrc-b

  reg:
    items:
      - description: Engine and coefficient SRAM ports
      - description: Channel synchronizer control

  reg-names:
    items:
      - const: engine
      - const: chsync

  clocks:
    items:
      - description: Peripheral bus gate
      - description: Output reference MCLK
      - description: Engine clock derived from reference MCLK

  clock-names:
    items:
      - const: pclk
      - const: mclk
      - const: clk

  power-domains:
    maxItems: 1

  '#sound-dai-cells':
    const: 0

required:
  - compatible
  - reg
  - reg-names
  - clocks
  - clock-names
  - power-domains
  - '#sound-dai-cells'

unevaluatedProperties: false
```

## Documentation/devicetree/bindings/sound/amlogic,t7-loopback.yaml
```yaml
# SPDX-License-Identifier: (GPL-2.0-only OR BSD-2-Clause)
%YAML 1.2
---
$id: http://devicetree.org/schemas/sound/amlogic,t7-loopback.yaml#
$schema: http://devicetree.org/meta-schemas/core.yaml#

title: Amlogic T7 microphone and playback reference combiner

maintainers:
  - localhost-copilot <318096335+localhost-copilot@users.noreply.github.com>

description: |
  The loopback engines concatenate selected microphone and playback reference
  channels. TDMIN LB performs reference deserialization; ASRC B optionally
  converts it to the microphone sample clock. Neither block is owned by the
  combiner. Loopback A and B feed TODDR sources 7 and 9 respectively.

allOf:
  - $ref: dai-common.yaml#

properties:
  compatible:
    const: amlogic,t7-loopback

  reg:
    maxItems: 1

  clocks:
    maxItems: 1

  clock-names:
    const: pclk

  resets:
    maxItems: 1

  power-domains:
    maxItems: 1

  '#sound-dai-cells':
    const: 0

required:
  - compatible
  - reg
  - clocks
  - clock-names
  - resets
  - power-domains
  - '#sound-dai-cells'

unevaluatedProperties: false
```
