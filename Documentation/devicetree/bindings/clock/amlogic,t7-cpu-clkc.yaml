## Documentation/devicetree/bindings/sound/amlogic,t7-vad.yaml
```yaml
# SPDX-License-Identifier: (GPL-2.0-only OR BSD-2-Clause)
%YAML 1.2
---
$id: http://devicetree.org/schemas/sound/amlogic,t7-vad.yaml#
$schema: http://devicetree.org/meta-schemas/core.yaml#

title: Amlogic T7 voice activity detector

maintainers:
  - localhost-copilot <318096335+localhost-copilot@users.noreply.github.com>

description: |
  The detector observes an existing 16 kHz PDM stream. Voice activity IRQs
  indicate speech energy, not keyword recognition. The audio fabric feed
  register is separate from the detector core. Retaining the PDM producer
  and its clocks during system suspend requires machine power policy.

allOf:
  - $ref: component-common.yaml#

properties:
  compatible:
    const: amlogic,t7-vad
  reg:
    items:
      - description: Detector core
      - description: Audio fabric feed control
  reg-names:
    items:
      - const: core
      - const: feed
  clocks:
    items:
      - description: Peripheral gate
      - description: Detector processing clock
  clock-names:
    items:
      - const: pclk
      - const: clk
  interrupts:
    items:
      - description: Voice activity
  interrupt-names:
    const: voice
  power-domains:
    maxItems: 1
  wakeup-source: true

required:
  - compatible
  - reg
  - reg-names
  - clocks
  - clock-names
  - interrupts
  - interrupt-names
  - power-domains

unevaluatedProperties: false
```

## Documentation/devicetree/bindings/usb/amlogic,t7-crg-udc.yaml
```yaml
# SPDX-License-Identifier: (GPL-2.0-only OR BSD-2-Clause)
%YAML 1.2
---
$id: http://devicetree.org/schemas/usb/amlogic,t7-crg-udc.yaml#
$schema: http://devicetree.org/meta-schemas/core.yaml#

title: Amlogic T7 Corigine USB device controller

maintainers:
  - localhost-copilot <318096335+localhost-copilot@users.noreply.github.com>

description:
  Peripheral controller beneath the T7 USB glue. The parent controls the
  PHYs, resets and power domain and must select peripheral mode.

properties:
  compatible:
    const: amlogic,t7-crg-udc

  reg:
    maxItems: 1

  interrupts:
    maxItems: 1

  clocks:
    maxItems: 1

  clock-names:
    const: core

required:
  - compatible
  - reg
  - interrupts
  - clocks
  - clock-names

additionalProperties: false

examples:
  - |
    #include <dt-bindings/interrupt-controller/arm-gic.h>

    usb@fdd00000 {
        compatible = "amlogic,t7-crg-udc";
        reg = <0xfdd00000 0x100000>;
        interrupts = <GIC_SPI 131 IRQ_TYPE_LEVEL_HIGH>;
        clocks = <&clkc 0>;
        clock-names = "core";
    };
```

## drivers/firmware/meson/Kconfig
```kconfig
# SPDX-License-Identifier: GPL-2.0-only
#
# Amlogic Secure Monitor driver
#
config MESON_SM
	tristate "Amlogic Secure Monitor driver"
	depends on ARCH_MESON || COMPILE_TEST
	default ARCH_MESON
	depends on ARM64_4K_PAGES
	help
	  Say y here to enable the Amlogic secure monitor driver

config MESON_T7_TEE
	bool "Amlogic T7 secure boot completion interface"
	depends on ARM64 && OPTEE && ARCH_MESON
	help
	  The tee_info/sys_boot_complete interface required by the T7 firmware
	  supplicant. Only the boot completion handshake is exposed.
```

## drivers/media/platform/amlogic/Kconfig
```kconfig
# SPDX-License-Identifier: GPL-2.0-only

comment "Amlogic media platform drivers"

config VIDEO_MESON_T7_DOS
	tristate
	help
	  Probe lifetime arbitration between T7 DOS decode and encode engines.

source "drivers/media/platform/amlogic/c3/Kconfig"
source "drivers/media/platform/amlogic/meson-ge2d/Kconfig"
source "drivers/media/platform/amlogic/t7-hdmirx/Kconfig"
source "drivers/media/platform/amlogic/t7-jpeg/Kconfig"
source "drivers/media/platform/amlogic/vdec/Kconfig"
```

## drivers/media/platform/amlogic/t7-hdmirx/Kconfig
```kconfig
# SPDX-License-Identifier: GPL-2.0-only
config VIDEO_MESON_T7_HDMIRX
	tristate "Amlogic T7 HDMI receiver bring-up"
	depends on ARCH_MESON || COMPILE_TEST
	depends on PM && DEBUG_FS
	depends on SND_SOC
	help
	  Manage the T7 HDMI receiver power domain and clocks, and expose
	  cable and register status through debugfs. Supports firmware EDID,
	  DDC/HPD, measured progressive input timings and HDMI PCM capture.
	  PHY, HDR and audio paths still require explicit module parameters.
	  The separate VDIN experiment exposes video capture through V4L2.

	  To compile this driver as a module, choose M here.

config VIDEO_MESON_T7_VDIN_TEST
	tristate "Amlogic T7 VDIN capture experiment"
	depends on VIDEO_MESON_T7_HDMIRX
	depends on VIDEO_DEV && OF && HAS_DMA
	select VIDEOBUF2_DMA_CONTIG
	help
	  Progressive RGB or NV12 capture, including measured UHD timings,
	  for the dedicated receiver DTBs. Exposes V4L2 streaming and DMA-buf
	  export with either a private copy ring or leased direct DMA buffers.
	  Owns the VPU register window; only the split-resource profile permits
	  coexistence with the fixed OSD1 display handoff. This experimental
	  resource and DMA ownership model still needs upstream integration.
```

## drivers/media/platform/amlogic/t7-jpeg/Kconfig
```kconfig
config VIDEO_MESON_T7_JPEG
	tristate "Amlogic T7 HCODEC JPEG encoder"
	depends on ARCH_MESON || COMPILE_TEST
	depends on ARM64 && PM
	select DMA_SHARED_BUFFER
	select VIDEO_MESON_T7_DOS
	help
	  JPEG 4:2:0 hardware encoding of linear NV12/NV21 buffers on T7.
	  Provides the jpegenc DMA import ABI used by vim4jpegenc.

config VIDEO_MESON_T7_JPEG_KUNIT_TEST
	tristate "T7 JPEG pure logic tests" if !KUNIT_ALL_TESTS
	depends on KUNIT
	depends on VIDEO_MESON_T7_JPEG
	default KUNIT_ALL_TESTS
	help
	  Check the production quality tables and JPEG header serializer.
	  Run these tests with KUnit without touching HCODEC hardware.
	  DMA ownership and actual image output require board validation.
	  The tests can also be built as an independent module.
```

## drivers/media/platform/amlogic/vdec/Kconfig
```kconfig
# SPDX-License-Identifier: (GPL-2.0-only OR MIT)

config VIDEO_AMLOGIC_VDEC
    tristate "Amlogic Video Decoder Driver"
    depends on ARCH_MESON || COMPILE_TEST
    depends on VIDEO_DEV
    depends on V4L_MEM2MEM_DRIVERS
    select VIDEOBUF2_DMA_CONTIG
    select V4L2_H264
    select V4L2_MEM2MEM_DEV
    select MESON_CANVAS
    select VIDEO_MESON_T7_DOS
    select REGMAP_MMIO
    select DMA_SHARED_BUFFER
    help
      This is a v4l2 driver for Amlogic video decoder driver.
	  This driver is designed to support V4L2 M2M STATELESS
	  interface.
      To compile this driver as a module choose m here.

config VIDEO_AMLOGIC_VDEC_KUNIT_TEST
	tristate "KUnit tests for Amlogic video decoder" if !KUNIT_ALL_TESTS
	depends on KUNIT
	depends on VIDEO_AMLOGIC_VDEC
	default KUNIT_ALL_TESTS
	help
	  Test parameter serialization and arithmetic boundaries without
	  requiring decoder hardware. These tests do not exercise DMA or
	  the firmware protocol.
	  Run the suite with the KUnit executor and the local .kunitconfig.
```

## drivers/misc/adla/Kconfig
```kconfig
# SPDX-License-Identifier: GPL-2.0
config AMLOGIC_ADLA_COMPAT
	tristate "Amlogic T7C ADLA downstream SDK compatibility"
	depends on ARM64 && OF && ARCH_MESON
	depends on PM && REGULATOR
	help
	  Downstream compatibility interface for the Amlogic ADLA SDK.
	  Exposes /dev/adla0 and the vendor ioctl, mmap and sysfs contracts.
	  This is not a DRM accelerator interface. Hardware validation is
	  required before use on T7C boards.

config AMLOGIC_ADLA_KUNIT_TEST
	tristate "KUnit tests for ADLA memory and cancellation" if !KUNIT_ALL_TESTS
	depends on KUNIT && AMLOGIC_ADLA_COMPAT
	default KUNIT_ALL_TESTS
	help
	  Test the production bitmap allocator, queued cancellation and
	  untrusted command bounds using real driver types and kernel lists.
	  DMA, recovery, power and ioctl lifetimes require board validation.
	  This suite may also be built as a separate KUnit module.
```
