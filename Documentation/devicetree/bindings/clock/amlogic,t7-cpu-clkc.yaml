## Documentation/devicetree/bindings/clock/amlogic,t7-cpu-clkc.yaml
```yaml
# SPDX-License-Identifier: (GPL-2.0-only OR BSD-2-Clause)
%YAML 1.2
---
$id: http://devicetree.org/schemas/clock/amlogic,t7-cpu-clkc.yaml#
$schema: http://devicetree.org/meta-schemas/core.yaml#

title: Amlogic T7 CPU Clock Controller

maintainers:
  - Igor Pecovnik <igor@armbian.com>

description:
  The A73 cluster runs from sys0_pll and the A53 cluster from sys1_pll, or
  from a dynamic clock derived from xtal or the fixed PLL dividers. Only the
  secure firmware can write these clocks, through the secure monitor. The
  register range holds the sys0_pll and sys1_pll control registers.

properties:
  compatible:
    const: amlogic,t7-cpu-clkc

  reg:
    maxItems: 1

  '#clock-cells':
    const: 1

  clocks:
    items:
      - description: oscillator input of the PLLs and the dynamic clocks
      - description: fixed PLL divided by 2
      - description: fixed PLL divided by 3
      - description: fixed PLL divided by 2.5

  clock-names:
    items:
      - const: xtal
      - const: fclk_div2
      - const: fclk_div3
      - const: fclk_div2p5

  amlogic,secure-monitor:
    $ref: /schemas/types.yaml#/definitions/phandle
    description: The secure monitor that programs the CPU clocks.

required:
  - compatible
  - reg
  - '#clock-cells'
  - clocks
  - clock-names
  - amlogic,secure-monitor

additionalProperties: false

examples:
  - |
    apb {
        #address-cells = <2>;
        #size-cells = <2>;

        clock-controller@8000 {
            compatible = "amlogic,t7-cpu-clkc";
            reg = <0 0x8000 0 0x40>;
            clocks = <&xtal>, <&scmi_clk 18>, <&scmi_clk 22>, <&scmi_clk 20>;
            clock-names = "xtal", "fclk_div2", "fclk_div3", "fclk_div2p5";
            amlogic,secure-monitor = <&sm>;
            #clock-cells = <1>;
        };
    };
```

## Documentation/devicetree/bindings/display/amlogic,meson-t7-hdmi-tx.yaml
```yaml
# SPDX-License-Identifier: (GPL-2.0-only OR BSD-2-Clause)
%YAML 1.2
---
$id: http://devicetree.org/schemas/display/amlogic,meson-t7-hdmi-tx.yaml#
$schema: http://devicetree.org/meta-schemas/core.yaml#

title: Amlogic T7 HDMI 2.1 Transmitter

maintainers:
  - Igor Pecovnik <igor@armbian.com>

description: |
  The HDMI transmitter of the Amlogic T7 SoC. It is not a Synopsys DesignWare
  core. It has a TOP block with 32-bit registers and a COR block with 8-bit
  registers. The video encoder (VENC) of the VPU feeds it, see
  amlogic,meson-vpu.yaml. The HDMI PHY registers are in the analog control
  block, which the VPU node describes.

properties:
  compatible:
    const: amlogic,t7-hdmi-tx

  amlogic,boot-handoff:
    type: boolean
    description: |
      Fixed 1080p firmware handoff. Read TOP/COR through the firmware SMC ABI;
      do not reset or program TX, PHY, DDC, audio, or clocks. Only valid with
      the dedicated T7 display-handoff consumer, not normal meson modesetting.

  amlogic,boot-monitor:
    type: boolean
    description: |
      Extend boot-handoff with EDID reads and HPD polling. DDC writes are
      allowed, but video, PHY and PLL programming remain forbidden. With
      sound-dai-cells this also enables two-channel PCM audio for the fixed
      firmware timing. The connector supplies EDID-derived ELD to hdmi-codec.

  hpd-gpios:
    maxItems: 1
    description: GPIOW15, active high, for the physical HDMI sink presence.

  reg:
    items:
      - description: TOP registers
      - description: COR registers

  reg-names:
    items:
      - const: top
      - const: cor

  interrupts:
    maxItems: 1

  clocks:
    items:
      - description: APB bus clock

  clock-names:
    items:
      - const: pclk

  resets:
    items:
      - description: HDMI TX controller reset
      - description: HDMI TX PHY reset

  reset-names:
    items:
      - const: hdmitx
      - const: phy

  power-domains:
    maxItems: 1

  "#sound-dai-cells":
    const: 0

  ports:
    $ref: /schemas/graph.yaml#/properties/ports

    properties:
      port@0:
        $ref: /schemas/graph.yaml#/properties/port
        description: Input from the VPU HDMI-TX port.

      port@1:
        $ref: /schemas/graph.yaml#/properties/port
        description: Output to the HDMI connector.

    required:
      - port@0
      - port@1

required:
  - compatible
  - reg
  - reg-names
  - interrupts
  - clocks
  - clock-names
  - power-domains
  - ports

additionalProperties: false

allOf:
  - if:
      required:
        - amlogic,boot-monitor
    then:
      required:
        - amlogic,boot-handoff
        - hpd-gpios
  - if:
      required:
        - amlogic,boot-handoff
        - "#sound-dai-cells"
    then:
      required:
        - amlogic,boot-monitor
  - if:
      not:
        required:
          - amlogic,boot-handoff
    then:
      required:
        - hpd-gpios

examples:
  - |
    #include <dt-bindings/interrupt-controller/arm-gic.h>

    hdmi-tx@fe300000 {
        compatible = "amlogic,t7-hdmi-tx";
        reg = <0xfe300000 0x10000>, <0xfe380000 0x10000>;
        reg-names = "top", "cor";
        interrupts = <GIC_SPI 204 IRQ_TYPE_LEVEL_HIGH>;
        clocks = <&clkc_periphs 194>;
        clock-names = "pclk";
        resets = <&reset 29>, <&reset 22>;
        reset-names = "hdmitx", "phy";
        power-domains = <&pwrc 14>;
        #sound-dai-cells = <0>;
        hpd-gpios = <&gpio 55 0>;

        ports {
            #address-cells = <1>;
            #size-cells = <0>;

            port@0 {
                reg = <0>;

                hdmi_tx_in: endpoint {
                    remote-endpoint = <&vpu_hdmi_out>;
                };
            };

            port@1 {
                reg = <1>;

                hdmi_tx_out: endpoint {
                    remote-endpoint = <&hdmi_connector_in>;
                };
            };
        };
    };
```

## Documentation/devicetree/bindings/display/amlogic,t7-display-handoff.yaml
```yaml
# SPDX-License-Identifier: (GPL-2.0-only OR BSD-2-Clause)
%YAML 1.2
---
$id: http://devicetree.org/schemas/display/amlogic,t7-display-handoff.yaml#
$schema: http://devicetree.org/meta-schemas/core.yaml#

title: Amlogic T7 fixed firmware display handoff experiment

maintainers:
  - localhost-copilot <318096335+localhost-copilot@users.noreply.github.com>

description: |
  Dedicated 1080p60 RGB888 OSD1 handoff. Firmware must have initialized the
  complete display path and reserved both logo frames at 3f800000/c00000.
  The normal VPU and simple-framebuffer nodes must remain disabled. VDIN
  must use disjoint capture resources. The handoff writes only the OSD1 address;
  the linear variant can also change OSD1 format, stride and alpha replacement
  at vsync to scan out linear RGB888, XRGB8888 and XBGR8888 DMA buffers.
  VENC, VIU interrupt routing, clocks, reset, VPP, timing and PHY stay unchanged.
  The firmware must select ENC2 and supply the VIU1 vsync edge interrupt.

properties:
  compatible:
    enum:
      - amlogic,t7-display-handoff
      - amlogic,t7-display-linear
  reg:
    items:
      - description: OSD1 control and linear MIF, ff006840/80
      - description: ENC2 timing readback, ff008db8/108
  reg-names:
    items:
      - const: osd1
      - const: venc
  interrupts:
    maxItems: 1
  memory-region:
    maxItems: 1
    description: Reserved no-map firmware logo frames, 3f800000/c00000
  clocks:
    items:
      - description: VPU interrupt and OSD register gate
      - description: VPU clock, reference only
      - description: VAPB clock, reference only
      - description: TX APB clock
      - description: HDMI PLL, reference only
  power-domains:
    items:
      - description: VPU HDMI island
      - description: VI CLK1 island
      - description: VI CLK2 island
  port:
    $ref: /schemas/graph.yaml#/properties/port
    description: Firmware-configured HDMI TX bridge input

required:
  - compatible
  - reg
  - reg-names
  - interrupts
  - memory-region
  - clocks
  - power-domains
  - port

additionalProperties: false
```

## Documentation/devicetree/bindings/display/amlogic,t7-display.yaml
```yaml
# SPDX-License-Identifier: (GPL-2.0-only OR BSD-2-Clause)
%YAML 1.2
---
$id: http://devicetree.org/schemas/display/amlogic,t7-display.yaml#
$schema: http://devicetree.org/meta-schemas/core.yaml#

title: Amlogic T7 ENC2 linear display experiment

maintainers:
  - localhost-copilot <318096335+localhost-copilot@users.noreply.github.com>

description: |
  OSD1 and ENC2 atomic modesetting with exclusive HDMI PLL ownership. Firmware
  must initialize the VIU1 to ENC2 route and reserve the logo frames. The normal
  VPU, simple-framebuffer and HDMI PLL clock provider must be disabled. VDIN
  uses split capture banks and exclusively owns write arbitration words
  0x27a2/0x27a3. Display must not initialize global arbitration, canvas or AFBC.
  Register DMA channel 1 and both interrupt sources are exclusive to display.
  The clock-controller regmap serializes masked display clock updates with CCF;
  RX clocks, VPU frequency, resets and power islands must not be changed.

properties:
  compatible:
    const: amlogic,t7-display
  reg:
    minItems: 12
    oneOf:
      - maxItems: 12
      - minItems: 14
    items:
      - description: OSD1, ff006840/80
      - description: ENC2 timing, ff008db8/608
      - description: Register DMA, ff004400/100
      - description: Exclusive HDMI PLL, fe0081c0/20
      - description: ENC2 video clocks, fe0001e0/20
      - description: HDMI video divider, fe000204/4
      - description: VPP OSD input and scopes, ff0077c4/18
      - description: OSD blend scopes and sizes, ff00e6c0/44
      - description: OSD1 scaler bypass, ff016820/4
      - description: VPP postblend size, ff007484/4
      - description: VPP output size, ff007694/4
      - description: HDMI mapping and sync polarity, ff009c6c/4
      - description: HDMI chroma formatter, ff009d0c/4
      - description: VPP0 OSD blend RGB to YUV matrix, ff00e440/38
  reg-names:
    minItems: 12
    oneOf:
      - maxItems: 12
      - minItems: 14
    items:
      - const: osd1
      - const: venc
      - const: rdma
      - const: pll
      - const: vid2
      - const: vid-div
      - const: vpp
      - const: blend
      - const: scaler
      - const: post-size
      - const: out-size
      - const: hdmi-setting
      - const: hdmi-format
      - const: osd-matrix
  amlogic,clock-controller:
    $ref: /schemas/types.yaml#/definitions/phandle
    description: T7 peripheral clock controller providing the shared MMIO regmap
  interrupts:
    items:
      - description: VIU1 vsync
      - description: RDMA completion
  clocks:
    items:
      - description: VPU interrupt gate
      - description: VPU reference
      - description: VAPB reference
      - description: TX APB gate
      - description: HDMI PLL oscillator, 24MHz
  power-domains:
    items:
      - description: VPU HDMI
      - description: VI CLK1
      - description: VI CLK2
  memory-region:
    maxItems: 1
    description: Reserved firmware logo frames
  port:
    $ref: /schemas/graph.yaml#/properties/port

required:
  - compatible
  - reg
  - reg-names
  - amlogic,clock-controller
  - interrupts
  - clocks
  - power-domains
  - memory-region
  - port

additionalProperties: false
```

## Documentation/devicetree/bindings/media/amlogic,t7-hdmirx.yaml
```yaml
# SPDX-License-Identifier: (GPL-2.0-only OR BSD-2-Clause)
%YAML 1.2
---
$id: http://devicetree.org/schemas/media/amlogic,t7-hdmirx.yaml#
$schema: http://devicetree.org/meta-schemas/core.yaml#

title: Amlogic T7 HDMI receiver

maintainers:
  - localhost-copilot <318096335+localhost-copilot@users.noreply.github.com>

description: |
  The receiver TOP window contains input 5V/HPD controls and per-port EDID RAM.
  The APB and receiver system gates are separate clocks; both are required for
  access to the DDC controller.

properties:
  compatible:
    const: amlogic,t7-hdmirx

  reg:
    maxItems: 1

  reg-names:
    items:
      - const: top

  clocks:
    maxItems: 6

  clock-names:
    items:
      - const: pclk
      - const: sys
      - const: cfg
      - const: meter
      - const: 2m
      - const: 5m

  power-domains:
    maxItems: 1

  amlogic,input-port:
    $ref: /schemas/types.yaml#/definitions/uint32
    description: Physical receiver input port to monitor.
    enum: [0, 1, 2]

required:
  - compatible
  - reg
  - reg-names
  - clocks
  - clock-names
  - power-domains
  - amlogic,input-port

additionalProperties: false

examples:
  - |
    #include <dt-bindings/clock/amlogic,t7-peripherals-clkc.h>
    #include <dt-bindings/power/amlogic,t7-pwrc.h>

    hdmi-receiver@fe398000 {
        compatible = "amlogic,t7-hdmirx";
        reg = <0xfe398000 0x4000>;
        reg-names = "top";
        power-domains = <&pwrc PWRC_T7_HDMIRX_ID>;
        clocks = <&clkc_periphs CLKID_SYS_HDMIRX_PCLK>,
                 <&clkc_periphs CLKID_SYS_HDMIRX>,
                 <&clkc_periphs CLKID_HDMIRX_CFG>,
                 <&clkc_periphs CLKID_HDMIRX_METER>,
                 <&clkc_periphs CLKID_HDMIRX_2M>,
                 <&clkc_periphs CLKID_HDMIRX_5M>;
        clock-names = "pclk", "sys", "cfg", "meter", "2m", "5m";
        amlogic,input-port = <1>;
    };
```

## Documentation/devicetree/bindings/media/amlogic,t7-jpeg-encoder.yaml
```yaml
# SPDX-License-Identifier: (GPL-2.0-only OR BSD-2-Clause)
%YAML 1.2
---
$id: http://devicetree.org/schemas/media/amlogic,t7-jpeg-encoder.yaml#
$schema: http://devicetree.org/meta-schemas/core.yaml#

title: Amlogic T7 HCODEC JPEG encoder

maintainers:
  - localhost-copilot <318096335+localhost-copilot@users.noreply.github.com>

description:
  The HCODEC block encodes JPEG images from linear YUV buffers. Its firmware
  is loaded through the platform secure monitor.

properties:
  compatible:
    const: amlogic,t7-jpeg-encoder

  reg:
    maxItems: 1

  interrupts:
    maxItems: 1

  clocks:
    maxItems: 3

  clock-names:
    items:
      - const: pclk
      - const: apb
      - const: core

  power-domains:
    maxItems: 1

required:
  - compatible
  - reg
  - interrupts
  - clocks
  - clock-names
  - power-domains

additionalProperties: false

examples:
  - |
    #include <dt-bindings/interrupt-controller/arm-gic.h>

    jpeg-encoder@fe320000 {
        compatible = "amlogic,t7-jpeg-encoder";
        reg = <0xfe320000 0x10000>;
        interrupts = <GIC_SPI 93 IRQ_TYPE_EDGE_RISING>;
        clocks = <&clkc 0>, <&clkc 1>, <&clkc 2>;
        clock-names = "pclk", "apb", "core";
        power-domains = <&pwrc 0>;
    };
```
