## drivers/misc/adla/Kconfig
```kconfig
# SPDX-License-Identifier: GPL-2.0
config AMLOGIC_ADLA_COMPAT
	tristate "Amlogic T7C ADLA downstream SDK compatibility"
	depends on ARM64 && OF && ARCH_MESON
	depends on PM && REGULATOR
	help
	  Downstream compatibility interface for the Amlogic ADLA SDK.
	  Exposes /dev/adla0 and the vendor ioctl, mmap and sysfs contracts.
	  This is not a DRM accelerator interface. Hardware validation is
	  required before use on T7C boards.

config AMLOGIC_ADLA_KUNIT_TEST
	bool "KUnit tests for ADLA mutex initialization" if !KUNIT_ALL_TESTS
	depends on KUNIT=y && AMLOGIC_ADLA_COMPAT && PROVE_LOCKING
	default KUNIT_ALL_TESTS
	help
	  Exercise allocated ADLA mutexes in device-to-SMMU lock order.
	  Check that initialization at distinct call sites preserves lockdep
	  instead of producing a recursive lock-class report.
	  No ADLA device or registers are accessed.
```
