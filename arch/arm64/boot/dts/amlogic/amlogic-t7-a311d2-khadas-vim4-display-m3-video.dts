// SPDX-License-Identifier: (GPL-2.0+ OR MIT)
/* Experimental display extension; the deployed default remains unchanged. */
#include "amlogic-t7-a311d2-khadas-vim4-display-m3.dts"

&{/display@ff006840} {
	amlogic,video-planes;
	reg = <0x0 0xff006840 0x0 0x80>,
	      <0x0 0xff008db8 0x0 0x608>,
	      <0x0 0xff004400 0x0 0x100>,
	      <0x0 0xfe0081c0 0x0 0x20>,
	      <0x0 0xfe0001e0 0x0 0x20>,
	      <0x0 0xfe000204 0x0 0x4>,
	      <0x0 0xff0077c4 0x0 0x18>,
	      <0x0 0xff00e6c0 0x0 0x44>,
	      <0x0 0xff016800 0x0 0x38>,
	      <0x0 0xff007484 0x0 0x4>,
	      <0x0 0xff007694 0x0 0x4>,
	      <0x0 0xff009c6c 0x0 0x4>,
	      <0x0 0xff009d0c 0x0 0x4>,
	      <0x0 0xff00e440 0x0 0x38>,
	      <0x0 0xff0068c0 0x0 0x80>,
	      <0x0 0xff00f600 0x0 0x80>,
	      <0x0 0xff016900 0x0 0x38>,
	      <0x0 0xff016a00 0x0 0x38>,
	      <0x0 0xff006834 0x0 0x8>,
	      <0x0 0xff006990 0x0 0xc>,
	      <0x0 0xff006af4 0x0 0x4>,
	      <0x0 0xff006b7c 0x0 0x4>,
	      <0x0 0xff006b3c 0x0 0x4>,
	      <0x0 0xff00f680 0x0 0x4>,
	      <0x0 0xff012000 0x0 0x104>,
	      <0x0 0xff012200 0x0 0x104>,
	      <0x0 0xff007404 0x0 0x80>,
	      <0x0 0xff0074d0 0x0 0x1c>,
	      <0x0 0xff00e4cc 0x0 0x78>,
	      <0x0 0xff007498 0x0 0x4>,
	      <0x0 0xff0075d8 0x0 0x4>,
	      <0x0 0xff0077ec 0x0 0x10>,
	      <0x0 0xff0077bc 0x0 0x4>,
	      <0x0 0xff00695c 0x0 0x8>,
	      <0x0 0xff00e000 0x0 0x4>,
	      <0x0 0xff00e140 0x0 0x4>,
	      <0x0 0xff0069e8 0x0 0x4>,
	      <0x0 0xff006a28 0x0 0x4>,
	      <0x0 0xff007698 0x0 0x4>,
	      <0x0 0xff00757c 0x0 0x4>,
	      <0x0 0xff006a0c 0x0 0x8>,
	      <0x0 0xff007644 0x0 0x8>,
	      <0x0 0xff012400 0x0 0x4>,
	      <0x0 0xff012500 0x0 0x4>,
	      <0x0 0xff00e680 0x0 0x38>;
	reg-names = "osd1", "venc", "rdma", "pll", "vid2", "vid-div",
		    "vpp", "blend", "scaler", "post-size", "out-size", "hdmi-setting",
		    "hdmi-format", "osd-matrix",
		    "osd2", "osd3", "scaler2", "scaler3", "osd-paths",
		    "osd2-address", "osd2-unpack", "dimm1", "dimm2", "dimm3",
		    "vd1-mif",
		    "vd2-mif",
		    "vd1-pps",
		    "vd1-pps-control",
		    "vd2-pps",
		    "video-misc",
		    "video-alpha",
		    "video-sources",
		    "vd3-source",
		    "video-hdr-size",
		    "vd1-hdr",
		    "vd2-hdr",
		    "video-path",
		    "video-start",
		    "video-size",
		    "video-matrix",
		    "video-dsc",
		    "video-sr",
		    "vd3-fetch",
		    "vd3-afbc", "post2-matrix";
	power-domains = <&pwrc PWRC_T7_VPU_HDMI_ID>,
			<&pwrc PWRC_T7_VI_CLK1_ID>, <&pwrc PWRC_T7_VI_CLK2_ID>,
			<&pwrc PWRC_T7_OSD1_MEM_ID>, <&pwrc PWRC_T7_OSD2_MEM_ID>,
			<&pwrc PWRC_T7_OSD3_MEM_ID>, <&pwrc PWRC_T7_OSD_SCALE_MEM_ID>,
			<&pwrc PWRC_T7_OSD2_SCALE_MEM_ID>, <&pwrc PWRC_T7_OSD_BLD34_MEM_ID>,
			<&pwrc PWRC_T7_RDMA_MEM_ID>,
			<&pwrc PWRC_T7_VD1_MEM_ID>, <&pwrc PWRC_T7_VD2_MEM_ID>,
			<&pwrc PWRC_T7_VD1_SCALE_MEM_ID>, <&pwrc PWRC_T7_VD2_SCALE_MEM_ID>,
			<&pwrc PWRC_T7_VD2_OFIFO_MEM_ID>;
};
