// SPDX-License-Identifier: (GPL-2.0+ OR MIT)
/* Fixed peripheral experiment. Keep the normal VIM4 DTB for recovery. */
#include "amlogic-t7-a311d2-khadas-vim4.dts"

&usb_comb {
	dr_mode = "peripheral";
};

&usb2_drd {
	compatible = "amlogic,t7-crg-udc";
};
